## config/west.yml
```yaml
manifest:
  remotes:
    - name: zmkfirmware
      url-base: https://github.com/zmkfirmware
    - name: hmngwy
      url-base: https://github.com/hmngwy
  projects:
    - name: zmk
      remote: hmngwy
      revision: main
      import: app/west.yml
  self:
    path: config
```
